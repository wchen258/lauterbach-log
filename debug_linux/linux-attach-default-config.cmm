; --------------------------------------------------------------------------------
; @Title: Linux-Attach script template for ZYNQ-ULTRASCALE+
; @Description:
;   Generic script template for Kernel/Module/Process debugging setup in TRACE32.
;   Prerequisites:
;   * please replace all <tbd> placeholders with your parameters
;   * linux is already booted
; @Keywords: Linux, Process, Module, Kernel
; @Props: Template
; @Author: AME
; @Board: -
; @Chip: IMX8M*
; @Copyright: (C) 1989-2019 Lauterbach GmbH, licensed for use with TRACE32(R) only
; --------------------------------------------------------------------------------
; $Id: linux-attach.cmm 13810 2019-01-21 11:16:59Z amerkle $


RESet
SYStem.RESet
SYStem.CPU ZYNQ-ULTRASCALE+-APU
; Assign all cores used by Linux to the debug session
; e.g. for ZYNQ-ULTASCALE+ all CA53 - CORE.ASSIGN 1. 2. 3. 4.
CORE.ASSIGN 1. 2. 3. 4.
SYStem.Option MMUSPACES ON
SYStem.Option IMASKASM ON
SYStem.Mode Attach

; load kernel debug symbols
Data.LOAD.Elf /home/zcu1023/Weifan/emb-linux/default_config/vmlinux /NoCODE

; setup debugger address translation
; this section massively depends on the kernel version and customer design decisions
; you may use ../generic_template/detect_translation.cmm to discover the settings applicable for your setup

MMU.FORMAT LINUXSWAP3 \\vmlinux\\swapper_pg_dir 0xffffffc011005000++0xfff 0x0000000001205000
TRANSlation.COMMON 0xf000000000000000--0xffffffffffffffff
TRANSlation.TableWalk ON
TRANSlation.ON


; load linux kernel awareness
TASK.CONFIG ~~/demo/arm64/kernel/linux/linux-3.x/linux3.t32
MENU.ReProgram ~~/demo/arm64/kernel/linux/linux-3.x/linux.men

IF STATE.RUN()
  Break

; configure Autoloader to your needs
sYmbol.AutoLOAD.CHECK ON ; [OFF, ON , ONGO]
;TASK.sYmbol.Option AutoLOAD <tbd.No>Process
;TASK.sYmbol.Option AutoLOAD <tbd.No>Module
;TASK.sYmbol.Option AutoLOAD <tbd.No>NoLibrary

ENDDO
